
/*
 * Advantech. eDP to lcd NT156WHM-n42, 15.6 inch
 *
 */

/ {
	disp_timings: display-timings {
		edp_NT156FHM_N43: edp-NT156FHM-N43 {
			screen-type = <SCREEN_EDP>;
			out-face    = <OUT_P888>;
			clock-frequency = <141400000>;
			hactive = <1920>;
			vactive = <1080>;
			hback-porch = <420>;
			hfront-porch = <111>;
			vback-porch = <420>;
			vfront-porch = <111>;
			hsync-len = <10>;
			vsync-len = <10>;
			hsync-active = <1>;
			vsync-active = <1>;
			de-active = <0>;
			pixelclk-active = <1>;
			swap-rb = <0>;
			swap-rg = <0>;
			swap-gb = <0>;
		};
	};
};
