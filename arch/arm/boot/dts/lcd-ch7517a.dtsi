/*
 * Advantech. eDP to VGA chip ch7517a
 *
 */

/ {
	disp_timings: display-timings {
		edp_1920x1200: 1920x1200 {
			screen-type = <SCREEN_EDP>;
			out-face    = <OUT_P666>;
			clock-frequency = <154000000>;
			hactive = <1920>;
			vactive = <1200>;
			hback-porch = <80>;
			hfront-porch = <48>;
			vback-porch = <26>;
			vfront-porch = <3>;
			hsync-len = <32>;
			vsync-len = <6>;
			hsync-active = <1>;
			vsync-active = <0>;
			de-active = <0>;
			pixelclk-active = <1>;
			swap-rb = <0>;
			swap-rg = <0>;
			swap-gb = <0>;
		};
		edp_1024x768: 1024x768 {
			screen-type = <SCREEN_EDP>;
			out-face    = <OUT_P666>;
			clock-frequency = <65000000>;
			hactive = <1024>;
			vactive = <768>;
			hback-porch = <160>;
			hfront-porch = <24>;
			vback-porch = <29>;
			vfront-porch = <3>;
			hsync-len = <136>;
			vsync-len = <6>;
			hsync-active = <0>;
			vsync-active = <0>;
			de-active = <0>;
			pixelclk-active = <1>;
			swap-rb = <0>;
			swap-rg = <0>;
			swap-gb = <0>;
		};
	};
};
