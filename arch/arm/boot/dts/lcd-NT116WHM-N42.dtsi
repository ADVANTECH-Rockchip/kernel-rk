
/*
 * Advantech. eDP to lcd NT156WHM-n42, 11.6 inch
 *
 */

/ {
	disp_timings: display-timings {
		edp_NT116WHM_N42: edp-NT116WHM-N42 {
			screen-type = <SCREEN_EDP>;
			out-face    = <OUT_P888>;
			clock-frequency = <74800000>;
			hactive = <1366>;
			vactive = <768>;
			hback-porch = <299>;
			hfront-porch = <100>;
			vback-porch = <299>;
			vfront-porch = <100>;
			hsync-len = <10>;
			vsync-len = <10>;
			hsync-active = <1>;
			vsync-active = <1>;
			de-active = <0>;
			pixelclk-active = <1>;
			swap-rb = <0>;
			swap-rg = <0>;
			swap-gb = <0>;
		};
	};
};
