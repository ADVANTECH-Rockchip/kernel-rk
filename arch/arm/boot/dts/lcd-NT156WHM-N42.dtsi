
/*
 * Advantech. eDP to lcd NT116FHM-n42, 15.6 inch
 *
 */

/ {
	disp_timings: display-timings {
		edp_NT156WHM_N42: edp-NT156WHM-N42 {
			screen-type = <SCREEN_EDP>;
			out-face    = <OUT_P888>;
			clock-frequency = <72300000>;
			hactive = <1366>;
			vactive = <768>;
			hback-porch = <299>;
			hfront-porch = <80>;
			vback-porch = <299>;
			vfront-porch = <80>;
			hsync-len = <10>;
			vsync-len = <10>;
			hsync-active = <1>;
			vsync-active = <1>;
			de-active = <0>;
			pixelclk-active = <1>;
			swap-rb = <0>;
			swap-rg = <0>;
			swap-gb = <0>;
		};
	};
};
